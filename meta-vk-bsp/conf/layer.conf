## meta-vk-bsp/conf/layer.conf
```bitbake
# We have a conf and classes directory, add to BBPATH
BBPATH .= ":${LAYERDIR}"


LICENSE_PATH += "${LAYERDIR}/licenses"

# We have recipes-* directories, add to BBFILES
BBFILES += "${LAYERDIR}/recipes-*/*/*.bb \
            ${LAYERDIR}/recipes-*/*/*.bbappend \
            ${LAYERDIR}/recipes-*/*/*/*.bb \
            ${LAYERDIR}/recipes-*/*/*/*.bbappend"

BBFILE_COLLECTIONS += "meta-vk-bsp"
BBFILE_PATTERN_meta-vk-bsp= "^${LAYERDIR}/"
BBFILE_PRIORITY_meta-vk-bsp = "16"

LAYERDEPENDS_meta-vk-bsp = "meta-rz-bsp"
LAYERSERIES_COMPAT_meta-vk-bsp = "scarthgap"

HOSTTOOLS += "xz"
```

## meta-vk-bsp/conf/machine/vk-d184280e.conf
```bitbake
#@TYPE: Machine
#@NAME: Vekatech VK-D184280E machine
#@DESCRIPTION: RZ/G2LC platform

require conf/machine/include/rzg2l-family.inc
require conf/machine/include/arm/armv8-2a/tune-cortexa55.inc
require conf/machine/include/rz-common.inc

# Trusted Firmware-A configuration
PREFERRED_VERSION_trusted-firmware-a ?= "2.9%"
TFA_PLATFORM ?= "g2l"
TFA_BOARD ?= "vkcmg2lc"
TFA_UBOOT ?= "1"
TFA_BUILD_TARGET ?= "bl2 bl31"
BL2_BOOT_TARGET ?= "emmc"
TFA_SPI_FLASH ?= "MX25L51245G"

BL2_ADJUST_VMA ?= "0x00011E00"
FIP_ADJUST_VMA ?= "0x0000"


UBOOT_CONFIG ??= "emmc"
UBOOT_CONFIG[emmc] = "vk-d184280e-emmc_defconfig"

PREFERRED_VERSION_u-boot = "2021.10%"

UENV_FILE ?= "uEnv-vk-d184280e.txt"

# Flash Writer configuration
FLASH_WRITER_BOARD ?= "VKCMG2LC"

# Support board with PMIC. Default:yes.
# With this option enabled, build both bin files for PMIC board and Concrete board.
VKBOARD_SUPPORT ?= "1"
CONFIG_WKS_eMMC ?= "1"

# Supported devicetree
KERNEL_DTS = " \
	vk-d184280e/vk-d184280e.dts \
"

KERNEL_DEVICETREE = ""

KERNEL_DEVICETREE_OVERLAY  = " \
    vk-d184280e/overlays/vko-can.dts \
    vk-d184280e/overlays/vko-cm33.dts \
	vk-d184280e/overlays/vko-i2c2.dts \
	vk-d184280e/overlays/vko-qspi-mx25l51245g.dts \
	vk-d184280e/overlays/vko-rs485.dts \
	vk-d184280e/overlays/vko-udma.dts \
"

BSP_SOC = "RZG2LC"
BSP_BOARD = "VK-D184280E/G2LC-v2.0"

# Wic image
WKS_FILE = " ${@oe.utils.conditional("CONFIG_WKS_eMMC", "1", "image-vkboard-mmc.wks", "image-vkrboard-esd.wks", d)} "


IMAGE_BOOT_FILES = " \
	bl2_bp_emmc-${MACHINE}.bin \
	fip_emmc-${MACHINE}.bin \
	bl2_bp_emmc-${MACHINE}.srec \
	fip_emmc-${MACHINE}.srec \
	Flash_Writer_SCIF_VKCMG2LC_DDR4_2GB_1PCS.mot \
"

# Deploy the uEnv.txt to the /boot directory
WKS_FILE_DEPENDS:append = " uenv"
IMAGE_BOOT_FILES += " uEnv.txt"
IMAGE_BOOT_FILES += " readme.txt"

IMAGE_BOOT_FILES += " ${KERNEL_IMAGETYPE}  vk-d184280e.dtb "

# Support DTB Overlay files
IMAGE_BOOT_FILES += " overlays/*;overlays/"
#IMAGE_BOOT_FILES += " cm33/*;cm33/"

#IMAGE_FSTYPES += " wic "
IMAGE_FSTYPES:remove = "tar.gz tar.bz2 wic.gz wic.bz2"
IMAGE_FSTYPES:append = " tar.xz wic wic.xz wic.bmap"

do_image_wic[depends] += "firmware-pack:do_deploy flash-writer:do_deploy"

MACHINE_FEATURES:append = " mali-g31 "

MACHINE_EXTRA_RRECOMMENDS:append = " kernel-modules"
```

## meta-vk-bsp/conf/machine/vkrzg2lc.conf
```bitbake
#@TYPE: Machine
#@NAME: vkrzg2lc machine
#@DESCRIPTION: VK-RZ/G2LC board

require conf/machine/include/rzg2l-family.inc
require conf/machine/include/arm/armv8-2a/tune-cortexa55.inc
require conf/machine/include/rz-common.inc

# Trusted Firmware-A configuration
PREFERRED_VERSION_trusted-firmware-a ?= "2.9%"
TFA_PLATFORM ?= "g2l"
TFA_BOARD ?= "vkrzg2lc"
TFA_UBOOT ?= "1"
TFA_BUILD_TARGET ?= "bl2 bl31"
BL2_BOOT_TARGET ?= "qspi emmc"
TFA_SPI_FLASH ?= "MX25L51245G"

BL2_ADJUST_VMA ?= "0x00011E00"
FIP_ADJUST_VMA ?= "0x0000"

# U-Boot Configuration
UBOOT_CONFIG ??= "qspi emmc"
UBOOT_CONFIG[qspi] = "vkrzg2lc-qspi_defconfig"
UBOOT_CONFIG[emmc] = "vkrzg2lc-emmc_defconfig"

PREFERRED_VERSION_u-boot = "2021.10%"

UENV_FILE ?= "uEnv-vkrzg2lc.txt"

# Flash Writer configuration
FLASH_WRITER_BOARD ?= "VKRZG2LC"

# Support board with PMIC. Default:yes.
# With this option enabled, build both bin files for PMIC board and Concrete board.
VKBOARD_SUPPORT ?= "1"
CONFIG_WKS_eMMC ?= "1"

# Supported devicetree
KERNEL_DTS = " \
    vkrzg2lc/vkrzg2lc.dts \
"

KERNEL_DEVICETREE = ""

KERNEL_DEVICETREE_OVERLAY  = " \
    vkrzg2lc/overlays/vkrz-audio.dts \
    vkrzg2lc/overlays/vkrz-can.dts \
    vkrzg2lc/overlays/vkrz-cm33.dts \
    vkrzg2lc/overlays/vkrz-csi-imx219.dts \
    vkrzg2lc/overlays/vkrz-dsi-av_disp2.dts \
    vkrzg2lc/overlays/vkrz-dsi-kd070hdfia030.dts \
    vkrzg2lc/overlays/vkrz-dsi-kd101wxfid045.dts \
    vkrzg2lc/overlays/vkrz-dsi-vklcd-ee0700.dts \
    vkrzg2lc/overlays/vkrz-dsi-vklcd07.dts \
    vkrzg2lc/overlays/vkrz-exp-i2c2.dts \
    vkrzg2lc/overlays/vkrz-exp-i2c3.dts \
    vkrzg2lc/overlays/vkrz-exp-pwm0.dts \
    vkrzg2lc/overlays/vkrz-exp-pwm1.dts \
    vkrzg2lc/overlays/vkrz-exp-scfi1.dts \
    vkrzg2lc/overlays/vkrz-exp-scfi1_rst_cts.dts \
    vkrzg2lc/overlays/vkrz-exp-scfi3.dts \
    vkrzg2lc/overlays/vkrz-exp-spi1.dts \
    vkrzg2lc/overlays/vkrz-udma.dts \
"

# Wic image
WKS_FILE = " ${@oe.utils.conditional("CONFIG_WKS_eMMC", "1", "image-vkboard-mmc.wks", "image-vkrboard-esd.wks", d)} " 


IMAGE_BOOT_FILES = " \
	bl2_bp_qspi-${MACHINE}.bin \
	bl2_bp_emmc-${MACHINE}.bin \
	fip_emmc-${MACHINE}.bin \
    fip_qspi-${MACHINE}.bin \
	bl2_bp_qspi-${MACHINE}.srec \
	bl2_bp_emmc-${MACHINE}.srec \
	fip_emmc-${MACHINE}.srec \
	fip_qspi-${MACHINE}.srec \
	Flash_Writer_SCIF_VKRZG2LC_DDR4_2GB_1PCS.mot \
"

# Deploy the uEnv.txt to the /boot directory
WKS_FILE_DEPENDS:append = " uenv"
IMAGE_BOOT_FILES += " uEnv.txt"
IMAGE_BOOT_FILES += " readme.txt"

IMAGE_BOOT_FILES += " ${KERNEL_IMAGETYPE} vkrzg2lc.dtb "

# Support DTB Overlay files
IMAGE_BOOT_FILES += " overlays/*;overlays/"

#IMAGE_FSTYPES += " wic "
IMAGE_FSTYPES:remove = "tar.gz tar.bz2 wic.gz wic.bz2"
IMAGE_FSTYPES:append = " tar.xz wic wic.xz wic.bmap"

do_image_wic[depends] += "firmware-pack:do_deploy flash-writer:do_deploy"

MACHINE_FEATURES:append = " mali-g31 "
```

## meta-vk-bsp/wic/image-vkboard-esd.wks
```
# short-description: Create SD card image with a boot partition
# long-description: Creates a partitioned SD card image. Boot files
# are located in the first vfat partition.

#part /boot --source bootimg-partition --ondisk mmcblk1 --fstype=vfat --label boot --active --align 16 --fixed-size 100
#part /boot --source bootimg-partition --ondisk mmcblk1 --fstype=vfat --label boot --active --align 8192 --size 100
#part / --source rootfs --ondisk mmcblk1 --fstype=ext4 --label root --align 16 --overhead-factor 1.0

#part --source rawcopy --sourceparams="file=bl2_bp_esd-${MACHINE}.bin" --no-table
#part --source rawcopy --sourceparams="file=fip-${MACHINE}.bin" --no-table --align 64

#part --source bootimg-partition --fstype=vfat --label bootloader --align 1024
#part --source rootfs            --fstype=ext4 --label root       --align 4

part /boot --source bootimg-partition --fstype=vfat  --label bootloader   --align 1024 --size 100M --use-uuid
part /     --source rootfs            --fstype=ext4  --label rootfs       --align 4    --use-uuid
```

## meta-vk-bsp/wic/image-vkboard-mmc.wks
```
# short-description: Create SD card image with a boot partition
# long-description: Creates a partitioned SD card image. Boot files
# are located in the first vfat partition.

#part /boot --source bootimg-partition --ondisk mmcblk0 --fstype=vfat --label boot --active --align 16 --fixed-size 100
#part /boot --source bootimg-partition --ondisk mmcblk0 --fstype=vfat --label boot --active --align 8192 --size 100
#part / --source rootfs --ondisk mmcblk0 --fstype=ext4 --label root --align 16 --overhead-factor 1.0

#part --source bootimg-partition --fstype=vfat --label boot --active     --align 1024 --size 100M
#part --source rootfs            --fstype=ext4 --label rootfs            --align 4

#part /boot --source bootimg-partition --fstype=vfat  --label bootloader  --align 1024 --size 100M --ondisk mmcblk
#part /     --source rootfs            --fstype=ext4  --label rootfs      --align 4    --ondisk mmcblk

part /boot --source bootimg-partition --fstype=vfat  --label bootloader   --align 1024 --size 100M --use-uuid
part /     --source rootfs            --fstype=ext4  --label rootfs       --align 4    --use-uuid
```

## meta-vk-distro/conf/layer.conf
```bitbake
# We have a conf and classes directory, add to BBPATH
BBPATH .= ":${LAYERDIR}"

# We have recipes-* directories, add to BBFILES
BBFILES += "${LAYERDIR}/recipes-*/*/*.bb \
            ${LAYERDIR}/recipes-*/*/*.bbappend"

BBFILE_COLLECTIONS += "meta-vk-distro"
BBFILE_PATTERN_meta-vk-distro = "^${LAYERDIR}/"
BBFILE_PRIORITY_meta-vk-distro = "16"

LAYERDEPENDS_meta-vk-distro = "meta-rz-distro meta-vk-bsp"
LAYERSERIES_COMPAT_meta-vk-distro = "scarthgap"
```
