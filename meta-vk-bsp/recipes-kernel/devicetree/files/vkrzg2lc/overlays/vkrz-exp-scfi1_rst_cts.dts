/*
 * Copyright 2023 Vekatech
 *
 * This program is free software; you can redistribute it and/or
 * modify it under the terms of the GNU General Public License
 * as published by the Free Software Foundation; either version 2
 * of the License, or (at your option) any later version.
 *
 * This program is distributed in the hope that it will be useful,
 * but WITHOUT ANY WARRANTY; without even the implied warranty of
 * MERCHANTABILITY or FITNESS FOR A PARTICULAR PURPOSE. See the
 * GNU General Public License for more details.
 */

/dts-v1/;
/plugin/;

#include <dt-bindings/pinctrl/rzg2l-pinctrl.h>

&scif1 {
	status = "okay";

	pinctrl-0 = <&scif1_pins>;
	pinctrl-names = "default";
	uart-has-rtscts;
};

&pinctrl {
	scif1_pins: scif1 {
		pinmux = <RZG2L_PORT_PINMUX(40, 0, 1)>, /* TxD */
			 <RZG2L_PORT_PINMUX(40, 1, 1)>, /* RxD */
			 <RZG2L_PORT_PINMUX(41, 0, 1)>, /* CTS# */
			 <RZG2L_PORT_PINMUX(41, 1, 1)>; /* RTS# */
	};
};
