/*
 * Copyright 2023 Vekatech
 *
 * This program is free software; you can redistribute it and/or
 * modify it under the terms of the GNU General Public License
 * as published by the Free Software Foundation; either version 2
 * of the License, or (at your option) any later version.
 *
 * This program is distributed in the hope that it will be useful,
 * but WITHOUT ANY WARRANTY; without even the implied warranty of
 * MERCHANTABILITY or FITNESS FOR A PARTICULAR PURPOSE. See the
 * GNU General Public License for more details.
 */

/dts-v1/;
/plugin/;

#include <dt-bindings/pinctrl/rzg2l-pinctrl.h>

&scif3 {
	status = "okay";

	pinctrl-0 = <&scif3_pins>;
	pinctrl-names = "default";
};

&pinctrl {
	scif3_pins: scif3 {
		pinmux = <RZG2L_PORT_PINMUX(0, 0, 5)>, /* TxD */
			 <RZG2L_PORT_PINMUX(0, 1, 5)>; /* RxD */
	};
};
