/*
 * Copyright 2024 Vekatech
 *
 * This program is free software; you can redistribute it and/or
 * modify it under the terms of the GNU General Public License
 * as published by the Free Software Foundation; either version 2
 * of the License, or (at your option) any later version.
 *
 * This program is distributed in the hope that it will be useful,
 * but WITHOUT ANY WARRANTY; without even the implied warranty of
 * MERCHANTABILITY or FITNESS FOR A PARTICULAR PURPOSE. See the
 * GNU General Public License for more details.
 */

/dts-v1/;
/plugin/;

#include <dt-bindings/interrupt-controller/arm-gic.h>


/ {
	compatible = "vekatech,vkrzg2lc", "renesas,r9a07g044";

	fragment@0 {
		target-path = "/";
		__overlay__ {
			#address-cells = <2>;
			#size-cells = <2>;

			udmabuf@0 {
				compatible = "ikwzm,u-dma-buf";
				device-name = "udmabuf0";
				minor-number = <0>;
				size = <0x4000000>; /* 64MiB */
				dma-coherent;
			};
		};
	};
};


